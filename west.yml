## west.yml
```yaml
# This west manifest replace default west manifest located in
# .platformio/packages/framework-zephyr/west.yml. Genuine
# default version is backup as west.yml.bak in the same folder
#
# This file defines the module dependencies of Zephyr RTOS.
# A script located in owntech/scripts/pre_west.py makes sure
# the local (project based) west.yml file supplant the default
# one.
#
# A power user can change dependencies version or add new ones
# at his will using the manifest below.

manifest:
  defaults:
    remote: upstream

  remotes:
    - name: upstream
      url-base: https://github.com/zephyrproject-rtos
    - name: owntech
      url-base: https://github.com/owntech-foundation
    - name: thingset
      url-base: https://github.com/thingset

  group-filter: [-optional]

  #
  # Please add items below based on alphabetical order
  projects:
    - name: cmsis
      revision: 4b96cbb174678dcd3ca86e11e1f24bc5f8726da0
      path: modules/hal/cmsis
      groups:
        - hal
    - name: cmsis-dsp
      revision: 6489e771e9c405f1763b52d64a3f17a1ec488ace
      path: modules/lib/cmsis-dsp
    - name: fatfs
      revision: 427159bf95ea49b7680facffaa29ad506b42709b
      path: modules/fs/fatfs
      groups:
        - fs
    # Use owntech fork of hal_stm32 that only ships STM32G4XX files
    # to reduce install size and time.
    - name: hal_stm32
      remote: owntech
      revision: 2e5897379cc6f69d33ea1f52f46f99cbe360a45d
      path: modules/hal/stm32
      groups:
        - hal
    - name: littlefs
      path: modules/fs/littlefs
      groups:
        - fs
      revision: 408c16a909dd6cf128874a76f21c793798c9e423
    - name: mcuboot
      revision: a4eda30f5b0cfd0cf15512be9dcd559239dbfc91
      path: bootloader/mcuboot
    - name: segger
      revision: 9d0191285956cef43daf411edc2f1a7788346def
      path: modules/debug/segger
      groups:
        - debug
    - name: tinycrypt
      revision: 3e9a49d2672ec01435ffbf0d788db6d95ef28de0
      path: modules/crypto/tinycrypt
      groups:
        - crypto
    # zcbor version changed to match thingset-node-c requirements
    - name: zcbor
      revision: 16648fb060d857f164635ca4e8eaa716d906d244
      path: modules/lib/zcbor
    - name: thingset-zephyr-sdk
      remote: thingset
      revision: 425cfce65fc85916c25829e6ce8308d018b7f5fd
      path: thingset-zephyr-sdk
      import:
        name-allowlist:
          - thingset-node-c
          - zcbor
    - name: thingset-node-c
      remote: thingset
      revision: d4a4540b6e914811a7a45c468a91b8627054829e
      path: modules/thingset-node-c
      import: true

  self:
    path: zephyr
    west-commands: scripts/west-commands.yml
    import: submanifests
```

## zephyr/dts/bindings/adc_trig.yaml
```yaml
description : This node is used to set adc triggers and sync it with power legs.

compatible : "adc-trig"

properties :

    current-pin-num :
      type : int
      required : true
      description : Current mode is used to control the output current. We use a comparator 
                    and DAC generation for slope compensation. The availability of the current
                    mode depends on the pin connected to the current measure. 
                    Below you can see every possible pin. Choose 0 if no pin is required. 

      # +----------+-----------------+
      # | GPIO PIN | SPIN PIN NUMBER |
      # +----------+-----------------+
      # | PA1      | 25              |
      # | PC1      | 30              |
      # +----------+-----------------+
      
    default-adc-trigger :
      type : string
      required : true
      description : Which adc trigger is used for data acquisition (only two leg can support it), 
                    if this leg isn't suposed to trigger the adc choose ADCTRIG_NONE.
      enum :
      - "ADCTRIG_NONE"
      - "ADCTRIG_1"
      - "ADCTRIG_2"
      - "ADCTRIG_3"
      - "ADCTRIG_4"

    default-edge-trigger :
      type : string
      required : true
      description : Only relevant in Center aligned. Choose when ADC is triggered, 
                    either when the counter is counting up, counting down or both. 
                    Keep EdgeTrigger_up as a default
      enum :
      - "EdgeTrigger_up"
      - "EdgeTrigger_down"
      - "EdgeTrigger_Both"

    default-adc-decim :
      type : int
      required : true
      description : The timer unit will trigger the ADC at the switching frequency, 
                    but you can divide this frequency with the number set by adc-decim 
                    (between 1 and 32). adc-decim = 2 means that the frequency of
                    the trigger is divided by 2. Keep adc-decim = 1 as default.
    
```
